## cpu/cc2538/radio/Kconfig
```kconfig
# Copyright (c) 2021 Jean Pierre Dudey
#
# This file is subject to the terms and conditions of the GNU Lesser
# General Public License v2.1. See the file LICENSE in the top level
# directory for more details.
#

## Default feature used to indicate that an O-QPSK PHY is present.
config HAS_RADIO_CC2538_RF_PHY_OQPSK
    bool
    default y if USEMODULE_CC2538_RF
    select HAS_IEEE802154_PHY_OQPSK
    help
        Dummy feature that is selected when the 'cc2538_rf' module is included,
        don't actually depend on this feature.

        This symbol will be removed when the Kconfig migration is complete and
        HAS_IEEE802154_PHY_OQPSK feature will be selected automatically when
        the module is included.
```

## sys/net/link_layer/ieee802154/Kconfig
```kconfig
# Copyright (c) 2020 HAW Hamburg
#
# This file is subject to the terms and conditions of the GNU Lesser
# General Public License v2.1. See the file LICENSE in the top level
# directory for more details.

## Related features
config HAS_IEEE802154_PHY_BPSK
    bool
    help
        Indicates that a radio that supports the BPSK PHY is present.

config HAS_IEEE802154_PHY_ASK
    bool
    help
        Indicates that a radio that supports the ASK PHY is present.

config HAS_IEEE802154_PHY_OQPSK
    bool
    help
        Indicates that a radio that supports the O-QPSK PHY is present.

config HAS_IEEE802154_PHY_MR_OQPSK
    bool
    help
        Indicates that a radio that supports the MR-O-QPSK PHY is present.

config HAS_IEEE802154_PHY_MR_OFDM
    bool
    help
        Indicates that a radio that supports the MR-OFDM PHY is present.

config HAS_IEEE802154_PHY_MR_FSK
    bool
    help
        Indicates that a radio that supports the MR-FSK PHY is present.

config HAS_IEEE802154_PHY_SUN
    bool
    default y if HAS_IEEE802154_PHY_MR_OQPSK || HAS_IEEE802154_PHY_MR_OFDM || HAS_IEEE802154_PHY_MR_FSK
    help
        Indicates that at least one of the SUN PHYs is available.

        SUN PHYs are:
            - MR-O-QPSK
            - MR-OFDM
            - MR-FSK

menuconfig KCONFIG_USEMODULE_IEEE802154
    bool "Configure IEEE802.15.4"
    depends on USEMODULE_IEEE802154
    help
        Configure IEEE802.15.4 module using Kconfig

if KCONFIG_USEMODULE_IEEE802154

    choice
        bool "IEEE802.15.4 default PHY mode"
        default IEEE802154_DEFAULT_PHY_OQPSK
        help
            IEEE802.15.4 default mode

        config IEEE802154_DEFAULT_PHY_BPSK
            bool "BPSK"
            depends on HAS_IEEE802154_PHY_BPSK
            help
                Binary Phase Shift Keying

        config IEEE802154_DEFAULT_PHY_ASK
            bool "ASK"
            depends on HAS_IEEE802154_PHY_ASK
            help
                Amplitude-Shift Keying

        config IEEE802154_DEFAULT_PHY_OQPSK
            bool "O-QPSK"
            depends on HAS_IEEE802154_PHY_OQPSK
            help
                Offset Quadrature Phase-Shift Keying

        config IEEE802154_DEFAULT_PHY_MR_OQPSK
            bool "MR-O-QPSK"
            depends on HAS_IEEE802154_PHY_MR_OQPSK
            help
                Multi-Rate Offset Quadrature Phase-Shift Keying

        config IEEE802154_DEFAULT_PHY_MR_OFDM
            bool "MR-OFDM"
            depends on HAS_IEEE802154_PHY_MR_OFDM
            help
                Multi-Rate Orthogonal Frequency-Division Multiplexing

        config IEEE802154_DEFAULT_PHY_MR_FSK
            bool "MR-FSK"
            depends on HAS_IEEE802154_PHY_MR_FSK
            help
                Multi-Rate Frequency Shift Keying

    endchoice # IEEE802.15.4 default PHY mode

    config IEEE802154_DEFAULT_SUBGHZ_CHANNEL
        int "IEEE802.15.4 default sub-GHZ channel"
        default 5

    config IEEE802154_DEFAULT_SUBGHZ_PAGE
        int "IEEE802.15.4 default sub-GHZ page"
        default 2

    config IEEE802154_DEFAULT_CHANNEL
        int "IEEE802.15.4 default channel"
        default 26

    config IEEE802154_DEFAULT_PANID
        hex "IEEE802.15.4 default PANID"
        default 0x0023
        range 0x0 0xFFFF

    config IEEE802154_DEFAULT_TXPOWER
        int "IEEE802.15.4 default TX power (in dBm)"
        default 0

    config IEEE802154_DEFAULT_CSMA_CA_MIN
        int "IEEE802.15.4 default CSMA-CA minimum backoff exponent"
        default 3

    config IEEE802154_DEFAULT_CSMA_CA_RETRIES
        int "IEEE802.15.4 default CSMA-CA maximum number of retries"
        default 4

    config IEEE802154_DEFAULT_CSMA_CA_MAX
        int "IEEE802.15.4 default CSMA-CA maximum backoff exponent"
        default 5

endif # KCONFIG_USEMODULE_IEEE802154
```
